## drivers/net/can/sunxi_can/Kconfig
```kconfig
#add by jiangdou for sunxi_can
config CAN_SUN7I
        tristate "Sun7i CAN bus controller"
        default n
        help
        This is the Sun7i CAN BUS driver for android system by peter chen.

		
```
